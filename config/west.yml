## config/west.yml
```yaml
manifest:
  remotes:
    - name: slicemk
      url-base: https://github.com/slicemk
    - name: englmaxi
      url-base: https://github.com/englmaxi      
  projects:
    - name: zmk
      remote: slicemk
      revision: main
      import: app/west.yml
    - name: zmk-hid-trackball-interface
      remote: englmaxi
      revision: main
  self:
    path: config
```
